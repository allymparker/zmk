## app/boards/shields/corneroll/Kconfig.shield
```kconfig
# Copyright (c) 2020 Pete Johanson
# SPDX-License-Identifier: MIT

config SHIELD_CORNEROLL_LEFT
    def_bool $(shields_list_contains,corneroll_left)

config SHIELD_CORNEROLL_RIGHT
    def_bool $(shields_list_contains,corneroll_right)
```
